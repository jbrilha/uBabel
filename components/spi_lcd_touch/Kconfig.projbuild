## components/spi_lcd_touch/Kconfig.projbuild
```kconfig
menu "Example Configuration"

    choice LCD_CONTROLLER
        prompt "LCD controller model"
        default LCD_CONTROLLER_ILI9341
        help
            Select LCD controller model

        config LCD_CONTROLLER_ILI9341
            bool "ILI9341"

        config LCD_CONTROLLER_ILI9488
            bool "ILI9488"
    endchoice

    config LCD_TOUCH_ENABLED
        bool "Enable LCD touch"
        default n
        help
            Enable this option if you wish to use display touch. You can select from touch controllers.

    choice LCD_TOUCH_CONTROLLER
        prompt "LCD touch controller model"
        depends on LCD_TOUCH_ENABLED
        default LCD_TOUCH_CONTROLLER_XPT2046
        help
            Select LCD touch controller model

        config LCD_TOUCH_CONTROLLER_STMPE610
            bool "STMPE610"
            help
                Touch controller STMPE610 connected via SPI.

        config LCD_TOUCH_CONTROLLER_XPT2046
            bool "XPT2046"
            help
                Touch controller XPT2046 connected via SPI.
    endchoice

    config LCD_MIRROR_Y
        int
        default 1 if LCD_TOUCH_ENABLED && LCD_TOUCH_CONTROLLER_XPT2046
        default 0
        help
            This value is 1 if XPT2046 touch controller is selected, 0 otherwise.

endmenu
```

## esp_peripherals/spi_lcd_touch/Kconfig.projbuild
```kconfig
menu "LCD / Touch Configuration"

    choice LCD_CONTROLLER
        prompt "LCD controller model"
        default LCD_CONTROLLER_ILI9341
        help
            Select LCD controller model

        config LCD_CONTROLLER_ILI9341
            bool "ILI9341"

        config LCD_CONTROLLER_ILI9342
            bool "ILI9342"

        config LCD_CONTROLLER_ILI9488
            bool "ILI9488"
    endchoice

    config LCD_TOUCH_ENABLED
        bool "Enable LCD touch (XPT2046)"
        default n
        help
            Enable this option if you wish to use display touch.

    choice LCD_ORIENTATION_LANDSCAPE
        prompt "Landscape orientation"
        default LCD_ORIENTATION_LANDSCAPE_90
        help
            Use display in landscape mode with given rotation

        config LCD_ORIENTATION_LANDSCAPE_90
            bool "90 Degrees"

        config LCD_ORIENTATION_LANDSCAPE_270
            bool "270 Degrees"
    endchoice

    config LCD_MIRROR_Y
        int
        default 1 if LCD_TOUCH_ENABLED
        default 0
        help
            This value is 1 if touch is enabled (due to the behavior of the XPT2046 controller), 0 otherwise.

endmenu
```

## sdkconfig.defaults
```kconfig
#
# Bluetooth
#
CONFIG_BT_ENABLED=y
# CONFIG_BT_BLUEDROID_ENABLED is not set
CONFIG_BT_NIMBLE_ENABLED=y
# CONFIG_BT_CONTROLLER_ONLY is not set
CONFIG_BT_CONTROLLER_ENABLED=y
# CONFIG_BT_CONTROLLER_DISABLED is not set

#
# NimBLE Options
#

#
# General
#
CONFIG_BT_NIMBLE_MEM_ALLOC_MODE_INTERNAL=y
# CONFIG_BT_NIMBLE_MEM_ALLOC_MODE_DEFAULT is not set
CONFIG_BT_NIMBLE_PINNED_TO_CORE=0
CONFIG_BT_NIMBLE_HOST_TASK_STACK_SIZE=4096
# end of General

#
# Roles and Profiles
#
CONFIG_BT_NIMBLE_ROLE_CENTRAL=y
CONFIG_BT_NIMBLE_ROLE_PERIPHERAL=y
CONFIG_BT_NIMBLE_ROLE_BROADCASTER=y
CONFIG_BT_NIMBLE_ROLE_OBSERVER=y
CONFIG_BT_NIMBLE_GATT_CLIENT=y
CONFIG_BT_NIMBLE_GATT_SERVER=y
# end of Roles and Profiles

#
# Security (SMP)
#
CONFIG_BT_NIMBLE_SECURITY_ENABLE=y
CONFIG_BT_NIMBLE_SM_LEGACY=y
CONFIG_BT_NIMBLE_SM_SC=y
# CONFIG_BT_NIMBLE_SM_SC_DEBUG_KEYS is not set
CONFIG_BT_NIMBLE_LL_CFG_FEAT_LE_ENCRYPTION=y
CONFIG_BT_NIMBLE_SM_LVL=0
CONFIG_BT_NIMBLE_SM_SC_ONLY=0
# end of Security (SMP)

#
# GAP / GATT / Device Settings
#
CONFIG_BT_NIMBLE_RPA_TIMEOUT=900
CONFIG_BT_NIMBLE_WHITELIST_SIZE=12
CONFIG_BT_NIMBLE_ENABLE_CONN_REATTEMPT=y
CONFIG_BT_NIMBLE_MAX_CONN_REATTEMPT=3
# CONFIG_BT_NIMBLE_HANDLE_REPEAT_PAIRING_DELETION is not set
# CONFIG_BT_NIMBLE_HOST_ALLOW_CONNECT_WITH_SCAN is not set
# CONFIG_BT_NIMBLE_HOST_QUEUE_CONG_CHECK is not set
CONFIG_BT_NIMBLE_MAX_CONNECTIONS=3
CONFIG_BT_NIMBLE_MAX_BONDS=3
CONFIG_BT_NIMBLE_MAX_CCCDS=8
# CONFIG_BT_NIMBLE_NVS_PERSIST is not set
# CONFIG_BT_NIMBLE_SMP_ID_RESET is not set
CONFIG_BT_NIMBLE_ATT_PREFERRED_MTU=256
CONFIG_BT_NIMBLE_ATT_MAX_PREP_ENTRIES=64
CONFIG_BT_NIMBLE_GATT_MAX_PROCS=4
CONFIG_BT_NIMBLE_CRYPTO_STACK_MBEDTLS=y
CONFIG_BT_NIMBLE_HS_STOP_TIMEOUT_MS=2000
CONFIG_BT_NIMBLE_USE_ESP_TIMER=y
# CONFIG_BT_NIMBLE_BLE_GATT_BLOB_TRANSFER is not set
# end of GAP / GATT / Device Settings

#
# L2CAP
#
CONFIG_BT_NIMBLE_L2CAP_COC_MAX_NUM=0
# end of L2CAP

#
# Memory Settings
#
CONFIG_BT_NIMBLE_MSYS_1_BLOCK_COUNT=24
CONFIG_BT_NIMBLE_MSYS_1_BLOCK_SIZE=128
CONFIG_BT_NIMBLE_MSYS_2_BLOCK_COUNT=24
CONFIG_BT_NIMBLE_MSYS_2_BLOCK_SIZE=320
CONFIG_BT_NIMBLE_MSYS_BUF_FROM_HEAP=y
CONFIG_BT_NIMBLE_TRANSPORT_ACL_FROM_LL_COUNT=24
CONFIG_BT_NIMBLE_TRANSPORT_ACL_SIZE=255
CONFIG_BT_NIMBLE_TRANSPORT_EVT_SIZE=70
CONFIG_BT_NIMBLE_TRANSPORT_EVT_COUNT=30
CONFIG_BT_NIMBLE_TRANSPORT_EVT_DISCARD_COUNT=8
CONFIG_BT_NIMBLE_L2CAP_COC_SDU_BUFF_COUNT=1
# end of Memory Settings

#
# BLE 5.x Features
#
CONFIG_BT_NIMBLE_50_FEATURE_SUPPORT=y
CONFIG_BT_NIMBLE_LL_CFG_FEAT_LE_2M_PHY=y
CONFIG_BT_NIMBLE_LL_CFG_FEAT_LE_CODED_PHY=y
CONFIG_BT_NIMBLE_EXT_ADV=y
# CONFIG_BT_NIMBLE_EXT_ADV_V2 is not set
CONFIG_BT_NIMBLE_MAX_EXT_ADV_INSTANCES=1
CONFIG_BT_NIMBLE_EXT_ADV_MAX_SIZE=1650
CONFIG_BT_NIMBLE_ENABLE_PERIODIC_ADV=y
CONFIG_BT_NIMBLE_PERIODIC_ADV_SYNC_TRANSFER=y
# CONFIG_BT_NIMBLE_PERIODIC_ADV_WITH_RESPONSES is not set
CONFIG_BT_NIMBLE_EXT_SCAN=y
CONFIG_BT_NIMBLE_ENABLE_PERIODIC_SYNC=y
CONFIG_BT_NIMBLE_MAX_PERIODIC_SYNCS=1
# CONFIG_BT_NIMBLE_ISO is not set
# end of BLE 5.x Features


#
# Services
#
CONFIG_BT_NIMBLE_PROX_SERVICE=y
CONFIG_BT_NIMBLE_ANS_SERVICE=y
CONFIG_BT_NIMBLE_CTS_SERVICE=y
CONFIG_BT_NIMBLE_HTP_SERVICE=y
CONFIG_BT_NIMBLE_IPSS_SERVICE=y
CONFIG_BT_NIMBLE_TPS_SERVICE=y
CONFIG_BT_NIMBLE_IAS_SERVICE=y
CONFIG_BT_NIMBLE_LLS_SERVICE=y
CONFIG_BT_NIMBLE_SPS_SERVICE=y
CONFIG_BT_NIMBLE_HR_SERVICE=y
# CONFIG_BT_NIMBLE_HID_SERVICE is not set
CONFIG_BT_NIMBLE_BAS_SERVICE=y
# CONFIG_BT_NIMBLE_SVC_BAS_BATTERY_LEVEL_NOTIFY is not set
CONFIG_BT_NIMBLE_DIS_SERVICE=y
# CONFIG_BT_NIMBLE_SVC_DIS_MANUFACTURER_NAME is not set
# CONFIG_BT_NIMBLE_SVC_DIS_SERIAL_NUMBER is not set
# CONFIG_BT_NIMBLE_SVC_DIS_HARDWARE_REVISION is not set
# CONFIG_BT_NIMBLE_SVC_DIS_FIRMWARE_REVISION is not set
# CONFIG_BT_NIMBLE_SVC_DIS_SOFTWARE_REVISION is not set
# CONFIG_BT_NIMBLE_SVC_DIS_SYSTEM_ID is not set
# CONFIG_BT_NIMBLE_SVC_DIS_PNP_ID is not set
# CONFIG_BT_NIMBLE_SVC_DIS_INCLUDED is not set
CONFIG_BT_NIMBLE_GAP_SERVICE=y
CONFIG_BT_NIMBLE_SVC_GAP_DEVICE_NAME="ubabel"
CONFIG_BT_NIMBLE_GAP_DEVICE_NAME_MAX_LEN=31
CONFIG_BT_NIMBLE_SVC_GAP_APPEARANCE=0
CONFIG_BT_NIMBLE_SVC_GAP_NAME_WRITE_PERM=0
CONFIG_BT_NIMBLE_SVC_GAP_NAME_WRITE_PERM_ENC=0
CONFIG_BT_NIMBLE_SVC_GAP_NAME_WRITE_PERM_AUTHEN=0
CONFIG_BT_NIMBLE_SVC_GAP_NAME_WRITE_PERM_AUTHOR=0
# CONFIG_BT_NIMBLE_SVC_GAP_GATT_SECURITY_LEVEL is not set
# CONFIG_BT_NIMBLE_SVC_GAP_RPA_ONLY is not set
CONFIG_BT_NIMBLE_SVC_GAP_CAR_CHAR_NOT_SUPP=y
# CONFIG_BT_NIMBLE_SVC_GAP_CAR_NOT_SUPP is not set
# CONFIG_BT_NIMBLE_SVC_GAP_CAR_SUPP is not set
CONFIG_BT_NIMBLE_SVC_GAP_CENT_ADDR_RESOLUTION=-1

#
# GAP Appearance write permissions
#
# CONFIG_BT_NIMBLE_SVC_GAP_APPEAR_WRITE is not set
CONFIG_BT_NIMBLE_SVC_GAP_APPEAR_WRITE_PERM=0
CONFIG_BT_NIMBLE_SVC_GAP_APPEAR_WRITE_PERM_ENC=0
CONFIG_BT_NIMBLE_SVC_GAP_APPEAR_WRITE_PERM_ATHN=0
CONFIG_BT_NIMBLE_SVC_GAP_APPEAR_WRITE_PERM_ATHR=0
# end of GAP Appearance write permissions

#
# GAP device name write permissions
#
# CONFIG_BT_NIMBLE_SVC_GAP_NAME_WRITE is not set
# end of GAP device name write permissions

#
# Peripheral Preferred Connection Parameters (PPCP) settings
#
CONFIG_BT_NIMBLE_SVC_GAP_PPCP_MAX_CONN_INTERVAL=0
CONFIG_BT_NIMBLE_SVC_GAP_PPCP_MIN_CONN_INTERVAL=0
CONFIG_BT_NIMBLE_SVC_GAP_PPCP_SLAVE_LATENCY=0
CONFIG_BT_NIMBLE_SVC_GAP_PPCP_SUPERVISION_TMO=0
# end of Peripheral Preferred Connection Parameters (PPCP) settings
# end of Services

#
# Extra Features
#
# CONFIG_BT_NIMBLE_DYNAMIC_SERVICE is not set
# CONFIG_BT_NIMBLE_GATT_CACHING is not set
# CONFIG_BT_NIMBLE_INCL_SVC_DISCOVERY is not set
# CONFIG_BT_NIMBLE_BLUFI_ENABLE is not set
# CONFIG_BT_NIMBLE_ENC_ADV_DATA is not set
# CONFIG_BT_NIMBLE_GATTC_PROC_PREEMPTION_PROTECT is not set
# CONFIG_BT_NIMBLE_GATTC_AUTO_PAIR is not set
CONFIG_BT_NIMBLE_EATT_CHAN_NUM=0
# CONFIG_BT_NIMBLE_SUBRATE is not set
# end of Extra Features

#
# NimBLE Mesh
#
# CONFIG_BT_NIMBLE_MESH is not set
# end of NimBLE Mesh

#
# Host-controller Transport
#
CONFIG_UART_HW_FLOWCTRL_DISABLE=y
# CONFIG_UART_HW_FLOWCTRL_CTS_RTS is not set
CONFIG_BT_NIMBLE_HCI_UART_FLOW_CTRL=0
CONFIG_BT_NIMBLE_HCI_UART_RTS_PIN=19
CONFIG_BT_NIMBLE_HCI_UART_CTS_PIN=23
# end of Host-controller Transport

#
# Debugging/Testing
#
# CONFIG_BT_NIMBLE_LOG_LEVEL_NONE is not set
# CONFIG_BT_NIMBLE_LOG_LEVEL_ERROR is not set
# CONFIG_BT_NIMBLE_LOG_LEVEL_WARNING is not set
CONFIG_BT_NIMBLE_LOG_LEVEL_INFO=y
# CONFIG_BT_NIMBLE_LOG_LEVEL_DEBUG is not set
CONFIG_BT_NIMBLE_LOG_LEVEL=1
CONFIG_BT_NIMBLE_PRINT_ERR_NAME=y
# CONFIG_BT_NIMBLE_DEBUG is not set
# CONFIG_BT_NIMBLE_TEST_THROUGHPUT_TEST is not set
# end of Debugging/Testing

#
# Vendor / Optimization
#
CONFIG_BT_NIMBLE_VS_SUPPORT=y
# CONFIG_BT_NIMBLE_OPTIMIZE_MULTI_CONN is not set
# CONFIG_BT_NIMBLE_HIGH_DUTY_ADV_ITVL is not set
# end of Vendor / Optimization
# end of NimBLE Options

#
# Controller Options
#

#
# HCI Config
#
CONFIG_BT_LE_HCI_INTERFACE_USE_RAM=y
# CONFIG_BT_LE_HCI_INTERFACE_USE_UART is not set
# end of HCI Config

CONFIG_BT_LE_CONTROLLER_NPL_OS_PORTING_SUPPORT=y
CONFIG_BT_LE_CONTROLLER_TASK_STACK_SIZE=4096

#
# Controller debug features
#
# CONFIG_BT_LE_CONTROLLER_LOG_ENABLED is not set
# CONFIG_BT_LE_ERROR_SIM_ENABLED is not set
# CONFIG_BT_LE_ASSERT_WHEN_ABNORMAL_DISCONN_ENABLED is not set
# CONFIG_BT_LE_DEBUG_REMAIN_SCENE_ENABLED is not set
# CONFIG_BT_LE_PTR_CHECK_ENABLED is not set
# CONFIG_BT_LE_MEM_CHECK_ENABLED is not set
# end of Controller debug features

CONFIG_BT_LE_LL_RESOLV_LIST_SIZE=4
CONFIG_BT_LE_LL_DUP_SCAN_LIST_COUNT=20
CONFIG_BT_LE_LL_SCA=60
# CONFIG_BT_LE_LL_PEER_SCA_SET_ENABLE is not set
# CONFIG_BT_LE_COEX_PHY_CODED_TX_RX_TLIM_EN is not set
CONFIG_BT_LE_COEX_PHY_CODED_TX_RX_TLIM_DIS=y
CONFIG_BT_LE_COEX_PHY_CODED_TX_RX_TLIM_EFF=0
# CONFIG_BT_LE_SLEEP_ENABLE is not set
CONFIG_BT_LE_LP_CLK_SRC_MAIN_XTAL=y
# CONFIG_BT_LE_LP_CLK_SRC_DEFAULT is not set
CONFIG_BT_CTRL_BLE_ADV_REPORT_FLOW_CTRL_SUPP=y
CONFIG_BT_CTRL_BLE_ADV_REPORT_FLOW_CTRL_NUM=100
CONFIG_BT_CTRL_BLE_ADV_REPORT_DISCARD_THRSHOLD=20
CONFIG_BT_LE_SCAN_DUPL=y
CONFIG_BT_LE_SCAN_DUPL_TYPE_DEVICE=y
# CONFIG_BT_LE_SCAN_DUPL_TYPE_DATA is not set
# CONFIG_BT_LE_SCAN_DUPL_TYPE_DATA_DEVICE is not set
CONFIG_BT_LE_SCAN_DUPL_TYPE=0
CONFIG_BT_LE_SCAN_DUPL_CACHE_REFRESH_PERIOD=0
CONFIG_BT_LE_MSYS_INIT_IN_CONTROLLER=y
# CONFIG_BT_LE_TX_CCA_ENABLED is not set
# CONFIG_BT_LE_DFT_TX_POWER_LEVEL_N24 is not set
# CONFIG_BT_LE_DFT_TX_POWER_LEVEL_N21 is not set
# CONFIG_BT_LE_DFT_TX_POWER_LEVEL_N18 is not set
# CONFIG_BT_LE_DFT_TX_POWER_LEVEL_N15 is not set
# CONFIG_BT_LE_DFT_TX_POWER_LEVEL_N12 is not set
# CONFIG_BT_LE_DFT_TX_POWER_LEVEL_N9 is not set
# CONFIG_BT_LE_DFT_TX_POWER_LEVEL_N6 is not set
# CONFIG_BT_LE_DFT_TX_POWER_LEVEL_N3 is not set
# CONFIG_BT_LE_DFT_TX_POWER_LEVEL_N0 is not set
# CONFIG_BT_LE_DFT_TX_POWER_LEVEL_P3 is not set
# CONFIG_BT_LE_DFT_TX_POWER_LEVEL_P6 is not set
CONFIG_BT_LE_DFT_TX_POWER_LEVEL_P9=y
# CONFIG_BT_LE_DFT_TX_POWER_LEVEL_P12 is not set
# CONFIG_BT_LE_DFT_TX_POWER_LEVEL_P15 is not set
# CONFIG_BT_LE_DFT_TX_POWER_LEVEL_P18 is not set
# CONFIG_BT_LE_DFT_TX_POWER_LEVEL_P20 is not set
CONFIG_BT_LE_DFT_TX_POWER_LEVEL_DBM_EFF=9
# CONFIG_BT_LE_CTRL_CHECK_CONNECT_IND_ACCESS_ADDRESS is not set
# CONFIG_BT_CTRL_RUN_IN_FLASH_ONLY is not set

#
# BLE disconnects when Instant Passed (0x28) occurs
#
# CONFIG_BT_LE_CTRL_LLCP_CONN_UPDATE is not set
# CONFIG_BT_LE_CTRL_LLCP_CHAN_MAP_UPDATE is not set
# CONFIG_BT_LE_CTRL_LLCP_PHY_UPDATE is not set
# end of BLE disconnects when Instant Passed (0x28) occurs

CONFIG_BT_CTRL_SCAN_BACKOFF_UPPERLIMITMAX=32
# CONFIG_BT_LE_CTRL_CHAN_ASS_EN is not set
CONFIG_BT_LE_CTRL_ADV_DATA_LENGTH_ZERO_AUX=y
CONFIG_BT_LE_RXBUF_OPT_ENABLED=y
CONFIG_BT_LE_CTRL_FAST_CONN_DATA_TX_EN=y

#
# Reserved Memory Config
#
CONFIG_BT_LE_EXT_ADV_RESERVED_MEMORY_COUNT=2
CONFIG_BT_LE_CONN_RESERVED_MEMORY_COUNT=2
# end of Reserved Memory Config

# CONFIG_BT_LE_DTM_ENABLED is not set

#
# Scheduling Priority Level Config
#
CONFIG_BT_LE_ADV_SCHED_PRIO_LOW_LEVEL=y
# CONFIG_BT_LE_ADV_SCHED_PRIO_MID_LEVEL is not set
# CONFIG_BT_LE_ADV_SCHED_PRIO_HIGH_LEVEL is not set
CONFIG_BT_LE_DFT_ADV_SCHED_PRIO_LEVEL=0
# CONFIG_BT_LE_PERIODIC_ADV_SCHED_PRIO_LOW_LEVEL is not set
CONFIG_BT_LE_PERIODIC_ADV_SCHED_PRIO_MID_LEVEL=y
# CONFIG_BT_LE_PERIODIC_ADV_SCHED_PRIO_HIGH_LEVEL is not set
CONFIG_BT_LE_DFT_PERIODIC_ADV_SCHED_PRIO_LEVEL=1
# CONFIG_BT_LE_SYNC_SCHED_PRIO_LOW_LEVEL is not set
CONFIG_BT_LE_SYNC_SCHED_PRIO_MID_LEVEL=y
# CONFIG_BT_LE_SYNC_SCHED_PRIO_HIGH_LEVEL is not set
CONFIG_BT_LE_DFT_SYNC_SCHED_PRIO_LEVEL=1
# end of Scheduling Priority Level Config
# end of Controller Options

#
# Common Options
#
CONFIG_BT_ALARM_MAX_NUM=50

#
# BLE Log
#
# CONFIG_BLE_LOG_ENABLED is not set
# end of BLE Log

# CONFIG_BT_BLE_LOG_SPI_OUT_ENABLED is not set
# CONFIG_BT_BLE_LOG_UHCI_OUT_ENABLED is not set
# CONFIG_BT_LE_USED_MEM_STATISTICS_ENABLED is not set
# end of Common Options

# CONFIG_BT_HCI_LOG_DEBUG_EN is not set
# end of Bluetooth

# Partition Table
#
# CONFIG_PARTITION_TABLE_SINGLE_APP is not set
# CONFIG_PARTITION_TABLE_SINGLE_APP_LARGE is not set
# CONFIG_PARTITION_TABLE_TWO_OTA is not set
# CONFIG_PARTITION_TABLE_TWO_OTA_LARGE is not set
CONFIG_PARTITION_TABLE_CUSTOM=y
CONFIG_PARTITION_TABLE_CUSTOM_FILENAME="partitions.csv"
CONFIG_PARTITION_TABLE_FILENAME="partitions.csv"
CONFIG_PARTITION_TABLE_OFFSET=0x8000
CONFIG_PARTITION_TABLE_MD5=y
# end of Partition Table
```

## sdkconfig.defaults.esp32c5
```kconfig
#
# Serial flasher config
#
CONFIG_ESPTOOLPY_NO_STUB=y
# CONFIG_ESPTOOLPY_FLASHMODE_QIO is not set
# CONFIG_ESPTOOLPY_FLASHMODE_QOUT is not set
CONFIG_ESPTOOLPY_FLASHMODE_DIO=y
# CONFIG_ESPTOOLPY_FLASHMODE_DOUT is not set
CONFIG_ESPTOOLPY_FLASH_SAMPLE_MODE_STR=y
CONFIG_ESPTOOLPY_FLASHMODE="dio"
CONFIG_ESPTOOLPY_FLASHFREQ_80M=y
# CONFIG_ESPTOOLPY_FLASHFREQ_40M is not set
# CONFIG_ESPTOOLPY_FLASHFREQ_20M is not set
CONFIG_ESPTOOLPY_FLASHFREQ="80m"
# CONFIG_ESPTOOLPY_FLASHSIZE_1MB is not set
# CONFIG_ESPTOOLPY_FLASHSIZE_2MB is not set
CONFIG_ESPTOOLPY_FLASHSIZE_4MB=y
# CONFIG_ESPTOOLPY_FLASHSIZE_8MB is not set
# CONFIG_ESPTOOLPY_FLASHSIZE_16MB is not set
# CONFIG_ESPTOOLPY_FLASHSIZE_32MB is not set
# CONFIG_ESPTOOLPY_FLASHSIZE_64MB is not set
# CONFIG_ESPTOOLPY_FLASHSIZE_128MB is not set
CONFIG_ESPTOOLPY_FLASHSIZE="4MB"
# CONFIG_ESPTOOLPY_HEADER_FLASHSIZE_UPDATE is not set
CONFIG_ESPTOOLPY_BEFORE_RESET=y
# CONFIG_ESPTOOLPY_BEFORE_NORESET is not set
CONFIG_ESPTOOLPY_BEFORE="default_reset"
CONFIG_ESPTOOLPY_AFTER_RESET=y
# CONFIG_ESPTOOLPY_AFTER_NORESET is not set
CONFIG_ESPTOOLPY_AFTER="hard_reset"
CONFIG_ESPTOOLPY_MONITOR_BAUD=115200
# end of Serial flasher config

#
# Zigbee
#
CONFIG_ZB_ENABLED=y
# CONFIG_ZB_ZCZR is not set
CONFIG_ZB_ZED=y
# CONFIG_ZB_ZGPD is not set
CONFIG_ZB_RADIO_NATIVE=y
# CONFIG_ZB_RADIO_SPINEL_UART is not set
```
